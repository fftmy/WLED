#include "wled.h"

#ifdef MYGAMES_BLUEPAD32
#include <NimBLEDevice.h> // BLE HID host (https://github.com/h2zero/NimBLE-Arduino)
#endif

/*
 * MyGames usermod
 *
 * Registers a 2D "Pong" effect for LED matrices: the player paddle (a 1x3
 * block in the rightmost column) against a red AI-controlled enemy paddle
 * in the leftmost column, with a small ball bouncing between them. Whoever
 * lets the ball pass their paddle loses; after the game ended, the
 * gamepad's A button restarts it.
 *
 * Effect controls (defined by the effect data string below):
 *  - Sliders : Speed = ball speed, Intensity = AI paddle skill
 *  - Colors  : slot 0 = player paddle + ball, slot 1 = background
 *              (the enemy paddle is always red)
 *
 * Bluetooth gamepad (only when built with -DMYGAMES_BLUEPAD32):
 *  - Left stick (up/down) / D-pad up-down : move the player paddle
 *  - A button : restart the game after it ended
 * Without a connected gamepad (or in builds without MYGAMES_BLUEPAD32) the
 * player paddle is AI-driven as well, so the panel plays itself as a demo.
 * Build with the personal environment in platformio_override.ini
 * (env:esp32s3dev_16MB_opi_gamepad). Works with BLE gamepads exposing a
 * standard HID service, e.g. the Xbox Wireless Controller in BLE mode
 * (Series X|S, or One S with firmware >= 4.x).
 */

// AI: below section was generated by an AI

// ---------------------------------------------------------------------------
// Effect slot id, resolved at setup() (strip.addEffect returns the assigned
// index). gpConsumeInput() compares it against the main segment's current
// effect, so the gamepad only moves the paddle while it is actually shown.
// ---------------------------------------------------------------------------
static uint8_t modePongId = 255;

// ---------------------------------------------------------------------------
// Bluetooth gamepad support: a small BLE HID host built on NimBLE-Arduino.
// Gated behind MYGAMES_BLUEPAD32 so environments without the library keep
// compiling unchanged.
//
// How it works:
//  1. Scan for advertising devices named "Xbox" or advertising the HID
//     gamepad appearance (0x03C4).
//  2. Connect, pair/bond (Just Works), then find the HID service (0x1812).
//  3. Read the Report Map characteristic (0x2A4B) and parse it to learn the
//     input report layout (report id, button bitmap, hat switch, axes).
//     Parsing the descriptor instead of hardcoding the report format keeps
//     this working across gamepad models and firmware versions.
//  4. Subscribe to input report notifications and map them to the paddle.
//
// Threading: NimBLE calls the scan/client/notify callbacks from its own
// FreeRTOS task, so the callbacks only store data (address, flags, the raw
// report bytes). All GATT operations, parsing and WLED state access happen
// in loop() context (see AGENTS.md "ESP32 Task Synchronization").
// ---------------------------------------------------------------------------
#ifdef MYGAMES_BLUEPAD32

#include <atomic>
#include <nvs_flash.h>

// Shared state between input processing (usermod loop(), main loop context)
// and the game effects (strip.service(), also main loop context). Both run
// on the same FreeRTOS task; the atomics just keep the compiler from caching
// stale values across the two call sites.
static std::atomic<int16_t> gpPaddleOff { 0 };  // paddle offset in px from panel center

// ---------------------------------------------------------------------------
// Minimal HID Report Map parser
// ---------------------------------------------------------------------------

// one axis field inside the input report
struct GpAxisField {
  uint8_t usage;       // HID generic-desktop usage (0x30 = X, 0x31 = Y, ...)
  uint8_t sizeBits;    // field width in bits
  uint16_t offsetBits; // field position inside the input report (after the id)
  int32_t logMin;      // declared Logical Minimum
  int32_t logMax;      // declared Logical Maximum; zero point = (min+max+1)/2
};

// layout of the gamepad input report, extracted from the Report Map
struct GpHidLayout {
  bool valid;
  bool gamepadish;      // report belongs to a gamepad/joystick collection
  uint8_t reportId;     // 0 = device does not use report ids
  uint8_t btnOffsetBits;
  uint8_t btnBits;      // button bitmap size in bits (0 = none found)
  uint8_t btnUsageMin;  // HID button usage of bit 0 (1 = button "A" on Xbox)
  uint8_t hatOffsetBits;
  uint8_t hatSizeBits;  // 0 = no hat switch found
  int32_t hatLogMin;    // declared hat logical range (Xbox: 1..8, 0 = neutral)
  int32_t hatLogMax;
  GpAxisField axes[6];
  uint8_t axisCount;
  int8_t axisX;         // index of the left-stick X/Y axes in axes[]
  int8_t axisY;
};

static GpHidLayout gpLayout = {};

struct GpParseState {
  // global items
  uint8_t usagePage;
  uint8_t reportId;
  uint16_t reportSize;
  uint16_t reportCount;
  int32_t logMin;      // global Logical Minimum (signed, sign-extended)
  int32_t logMax;      // global Logical Maximum
  // global Push/Pop stack (rarely used, kept for correctness)
  struct { uint8_t usagePage; uint16_t reportSize; uint16_t reportCount; int32_t logMin; int32_t logMax; } stack[4];
  uint8_t stackDepth;
  // local items
  uint16_t usageList[8]; // explicit usages, page = current usagePage
  uint8_t usageCount;
  uint16_t usageMin;
  uint16_t usageMax;
  bool haveUsageRange;
  // collection path: colStack[d] = path up to depth d contains a gamepad-ish
  // (joystick/gamepad/multi-axis) collection
  bool colStack[8];
  uint8_t colDepth;
  // current input report candidate
  GpHidLayout cur;
  uint16_t curOffsetBits;
  bool curActive;
  // best candidate found so far
  GpHidLayout best;
  uint8_t bestScore;
};

// record an axis or hat-switch field for one usage of the generic desktop page
static void gpAddField(GpParseState* st, uint16_t usage, uint16_t offsetBits, uint16_t sizeBits)
{
  if (st->usagePage != 0x01) return; // generic desktop page only
  if (usage >= 0x30 && usage <= 0x38 && st->cur.axisCount < 6) {
    GpAxisField& f = st->cur.axes[st->cur.axisCount];
    f.usage = usage;
    f.sizeBits = sizeBits;
    f.offsetBits = offsetBits;
    f.logMin = st->logMin;
    f.logMax = st->logMax;
    // the left stick is the FIRST X/Y pair in declaration order; the Xbox map
    // labels it Rx/Ry (0x33/0x34) and its "X"/"Y" usages belong to the right
    // stick, so matching by usage id picks the wrong pair
    if (st->cur.axisX < 0) st->cur.axisX = st->cur.axisCount;
    else if (st->cur.axisY < 0) st->cur.axisY = st->cur.axisCount;
    st->cur.axisCount++;
  } else if (usage == 0x39) { // hat switch
    st->cur.hatOffsetBits = offsetBits;
    st->cur.hatSizeBits = sizeBits;
    st->cur.hatLogMin = st->logMin;
    st->cur.hatLogMax = st->logMax;
  }
}

// compare the finished candidate against the best one found so far
static void gpEvaluateCandidate(GpParseState* st)
{
  if (!st->curActive) return;
  uint8_t score = st->cur.axisCount;
  if (st->cur.gamepadish) score += 8;
  if (st->cur.btnBits) score += 2;
  if (st->cur.axisX >= 0 && st->cur.axisY >= 0 && st->cur.btnBits) score += 4;
  if (score > st->bestScore) {
    st->best = st->cur;
    st->bestScore = score;
  }
  st->curActive = false;
}

// parse the raw Report Map descriptor bytes and fill gpLayout
static void gpParseReportMap(const uint8_t* data, size_t len)
{
  GpParseState st = {};
  st.usagePage = 0x01; // default per HID spec

  size_t i = 0;
  while (i < len) {
    const uint8_t hdr = data[i++];
    if (hdr == 0xFE) { // long item: skip (not used by gamepads)
      if (i >= len) break;
      i += (size_t)data[i] + 1;
      continue;
    }
    const uint8_t tag = (hdr >> 4) & 0x0F;
    const uint8_t type = (hdr >> 2) & 0x03;  // 0=main 1=global 2=local
    const uint8_t szCode = hdr & 0x03;       // length code: 0, 1, 2 or 4 bytes
    const uint8_t szField = (szCode == 3) ? 4 : szCode; // code 3 means 4 bytes
    if (i + szField > len) break;
    uint32_t val = 0;
    for (uint8_t b = 0; b < szField; b++) val |= (uint32_t)data[i + b] << (8 * b);
    i += szField;

    if (type == 1) { // ---------------------------------------------------------------- global
      switch (tag) {
        case 0x00: st.usagePage = val & 0xFF; break;       // Usage Page
        case 0x07: st.reportSize = val; break;             // Report Size
        case 0x08: st.reportId = val & 0xFF; break;        // Report ID
        case 0x09: st.reportCount = val; break;            // Report Count
        case 0x01: // Logical Minimum (signed)
        case 0x02: { // Logical Maximum (signed)
          // sign-extend by field width, e.g. -1 in 8 bits = 0xFF
          int32_t sval = (int32_t)val;
          if (szField && szField < 4 && (val & (1u << (szField * 8 - 1))))
            sval = (int32_t)(val | (0xFFFFFFFFu << (szField * 8)));
          if (tag == 0x01) st.logMin = sval; else st.logMax = sval;
          break;
        }
        case 0x0A: // Push
          if (st.stackDepth < 4) {
            st.stack[st.stackDepth].usagePage = st.usagePage;
            st.stack[st.stackDepth].reportSize = st.reportSize;
            st.stack[st.stackDepth].reportCount = st.reportCount;
            st.stack[st.stackDepth].logMin = st.logMin;
            st.stack[st.stackDepth].logMax = st.logMax;
            st.stackDepth++;
          }
          break;
        case 0x0B: // Pop
          if (st.stackDepth) {
            st.stackDepth--;
            st.usagePage = st.stack[st.stackDepth].usagePage;
            st.reportSize = st.stack[st.stackDepth].reportSize;
            st.reportCount = st.stack[st.stackDepth].reportCount;
            st.logMin = st.stack[st.stackDepth].logMin;
            st.logMax = st.stack[st.stackDepth].logMax;
          }
          break;
        default: break; // Logical/Physical Min/Max, Unit: not needed here
      }
    } else if (type == 2) { // -------------------------------------------------------- local
      switch (tag) {
        case 0x00: if (st.usageCount < 8) st.usageList[st.usageCount++] = val; break; // Usage
        case 0x01: st.usageMin = val; st.haveUsageRange = true; break;                // Usage Minimum
        case 0x02: st.usageMax = val; break;                                          // Usage Maximum
        default: break; // designators/delimiters: not needed here
      }
    } else if (type == 0) { // -------------------------------------------------------- main
      switch (tag) {
        case 0x0A: { // Collection
          bool gp = false;
          if (st.usagePage == 0x01) {
            const uint16_t cu = st.usageCount ? st.usageList[0] : (st.haveUsageRange ? st.usageMin : 0);
            if (cu == 0x04 || cu == 0x05 || cu == 0x08) gp = true; // joystick / gamepad / multi-axis
          }
          if (st.colDepth < 8) {
            st.colStack[st.colDepth] = gp || (st.colDepth ? st.colStack[st.colDepth - 1] : false);
            st.colDepth++;
          }
          // HID spec: ANY main item resets the local item state. Collections
          // must clear it too - the Xbox map tags each stick pair with a
          // "Pointer" usage inside a nested collection, and those stale
          // usages would otherwise shift every following field by one slot.
          st.usageCount = 0;
          st.haveUsageRange = false;
          st.usageMin = st.usageMax = 0;
          break;
        }
        case 0x0C: // End Collection
          if (st.colDepth) st.colDepth--;
          st.usageCount = 0;
          st.haveUsageRange = false;
          st.usageMin = st.usageMax = 0;
          break;
        case 0x08: { // Input
          const bool isData = !(val & 0x01); // bit0: Data(0)/Const(1)
          const bool isVar = val & 0x02;     // bit1: Array(0)/Var(1)
          const uint16_t bits = st.reportSize * st.reportCount;

          // a different (or first) report id starts a new candidate layout
          if (!st.curActive || st.reportId != st.cur.reportId) {
            gpEvaluateCandidate(&st);
            st.cur = GpHidLayout {};
            st.cur.reportId = st.reportId;
            // GpHidLayout{} zero-initializes these, but 0 is a VALID axis
            // index - mark "unset" explicitly or they never get assigned and
            // X and Y both read axes[0]
            st.cur.axisX = -1;
            st.cur.axisY = -1;
            st.curOffsetBits = 0;
            st.curActive = true;
          }
          if (st.colDepth && st.colStack[st.colDepth - 1]) st.cur.gamepadish = true;

          if (isData && isVar && st.curActive) {
            if (st.usagePage == 0x09 && st.haveUsageRange && !st.cur.btnBits) {
              // button bitmap: bit i = usage (usageMin + i)
              st.cur.btnOffsetBits = st.curOffsetBits;
              st.cur.btnBits = (bits > 255) ? 255 : bits;
              st.cur.btnUsageMin = st.usageMin;
            } else {
              // axes / hat: one usage per field
              if (st.haveUsageRange) {
                // cap the loop: a malformed range must not spin 65536 times
                for (uint16_t u = st.usageMin; u <= st.usageMax && u - st.usageMin < 32; u++)
                  gpAddField(&st, u, st.curOffsetBits + (u - st.usageMin) * st.reportSize, st.reportSize);
              } else {
                for (uint8_t k = 0; k < st.usageCount; k++)
                  gpAddField(&st, st.usageList[k], st.curOffsetBits + k * st.reportSize, st.reportSize);
              }
            }
          }
          st.curOffsetBits += bits;
          // input items clear the local item state
          st.usageCount = 0;
          st.haveUsageRange = false;
          st.usageMin = st.usageMax = 0;
          break;
        }
        case 0x09: // Output
        case 0x0B: // Feature
          // not collected, but they clear local item state
          st.usageCount = 0;
          st.haveUsageRange = false;
          st.usageMin = st.usageMax = 0;
          break;
        default: break;
      }
    }
  }
  gpEvaluateCandidate(&st);

  // a usable gamepad report needs at least the two stick axes
  gpLayout = st.best;
  gpLayout.valid = (st.bestScore > 0) && (st.best.axisX >= 0) && (st.best.axisY >= 0);
  // hats without a declared logical range: standard HID hat uses 0..7
  if (gpLayout.hatSizeBits && gpLayout.hatLogMax <= gpLayout.hatLogMin) {
    gpLayout.hatLogMin = 0;
    gpLayout.hatLogMax = 7;
  }

  DEBUG_PRINTF_P(PSTR("MyGames: HID map parsed: reportId=%u btn=%u bits@%u hat=%u bits@%u range=%d..%d axes=%u valid=%u\n"),
    gpLayout.reportId, gpLayout.btnBits, gpLayout.btnOffsetBits, gpLayout.hatSizeBits,
    gpLayout.hatOffsetBits, (int)gpLayout.hatLogMin, (int)gpLayout.hatLogMax,
    gpLayout.axisCount, gpLayout.valid);
  for (uint8_t k = 0; k < gpLayout.axisCount; k++) {
    const GpAxisField& f = gpLayout.axes[k];
    DEBUG_PRINTF_P(PSTR("MyGames:  axis %u: usage 0x%02x bits@%u size=%u range=%d..%d%s%s\n"),
      k, f.usage, f.offsetBits, f.sizeBits, (int)f.logMin, (int)f.logMax,
      (k == gpLayout.axisX) ? " [X]" : "", (k == gpLayout.axisY) ? " [Y]" : "");
  }
}

// extract up to 32 bits (HID bit order: LSB first) from a report buffer
static uint32_t gpGetBits(const uint8_t* rep, uint16_t offsetBits, uint8_t sizeBits)
{
  uint32_t v = 0;
  for (uint8_t b = 0; b < sizeBits && b < 32; b++) {
    const uint16_t bit = offsetBits + b;
    v |= (uint32_t)((rep[bit >> 3] >> (bit & 7)) & 1) << b;
  }
  return v;
}

// convert one axis field to a ±32768-range signed value, re-centered on the
// declared logical range (gamepad sticks are usually unsigned 0..65535 with
// the zero point at 32768; treating them as signed yields near-zero readings)
static int32_t gpAxisValue(const uint8_t* rep, const GpAxisField& f)
{
  if (f.sizeBits < 2 || f.sizeBits > 16) return 0; // unsupported field width
  const uint32_t v = gpGetBits(rep, f.offsetBits, f.sizeBits);
  // signed axis (e.g. Logical Min < 0): interpret the raw bits as signed
  if (f.logMin < 0 && f.logMax >= 0) {
    const int32_t half = 1 << (f.sizeBits - 1);
    return (v < (uint32_t)half) ? (int32_t)v : (int32_t)v - (1 << f.sizeBits);
  }
  // unsigned axis: zero point at the middle of the declared range
  int32_t center;
  if (f.logMax > f.logMin) center = (f.logMin + f.logMax + 1) / 2;
  else center = 1 << (f.sizeBits - 1); // no usable range: assume unsigned
  // scale to ±32768 so the deadzone thresholds stay independent of field width
  int32_t diff = (int32_t)v - center;
  if (f.sizeBits && f.sizeBits < 16) diff *= (1 << (16 - f.sizeBits));
  return diff;
}

// ---------------------------------------------------------------------------
// BLE host: scan, connect, subscribe
// ---------------------------------------------------------------------------

// latest HID notification; written from the NimBLE task, consumed by loop()
static uint8_t gpReport[32];
static volatile size_t gpReportLen = 0;
static bool gpNoReportId = false;   // device sends input reports WITHOUT the id byte
static uint8_t gpIdMismatch = 0;    // consecutive notifications with unexpected id byte

static NimBLEClient* gpClient = nullptr;
static NimBLEAddress gpTargetAddr;
static volatile bool gpTargetFound = false;
static volatile bool gpClientLost = false;
static volatile bool gpAuthDone = false;      // pairing/bonding finished (NimBLE task)
static volatile bool gpHidConfigured = false; // report map parsed and subscribed
static unsigned long gpRescanAt = 0;
static unsigned long gpConnectAt = 0;         // millis() when connect succeeded

static void gpNotifyCb(NimBLERemoteCharacteristic* c, uint8_t* data, size_t len, bool isNotify)
{
  // NimBLE task context: only copy the report, never touch WLED state
  if (len <= sizeof(gpReport)) {
    memcpy(gpReport, data, len);
    gpReportLen = len;
  }
}

// scan-complete callback; the continuous scan only stops on error/host reset,
// restarts are handled in gpTask()
static void gpScanCompleteCb(NimBLEScanResults results) {}

class GpScanCallbacks : public NimBLEAdvertisedDeviceCallbacks {
  void onResult(NimBLEAdvertisedDevice* dev) override {
    if (gpTargetFound || gpClient) return;
    bool match = false;
    if (dev->haveName() && dev->getName().find("Xbox") != std::string::npos) match = true;
    if (!match && dev->haveAppearance() && dev->getAppearance() == 0x03C4) match = true; // HID gamepad
    if (match) {
      gpTargetAddr = dev->getAddress();
      gpTargetFound = true;
      DEBUG_PRINTLN(F("MyGames: BLE gamepad found."));
    }
  }
};
static GpScanCallbacks gpScanCallbacks;

class GpClientCallbacks : public NimBLEClientCallbacks {
  void onDisconnect(NimBLEClient* c) override { gpClientLost = true; }
  uint32_t onPassKeyRequest() override { return 0; }
  bool onConfirmPIN(uint32_t pin) override { return true; } // Just Works pairing
  // security procedure finished (success or failure). Strict devices like the
  // Xbox controller only allow encrypted GATT reads of their HID report map
  // once this has fired; permissive devices are handled by a 3 s timeout.
  void onAuthenticationComplete(ble_gap_conn_desc* desc) override { gpAuthDone = true; }
};
static GpClientCallbacks gpClientCallbacks;

// connect to the found gamepad and start pairing/bonding. Pairing is
// asynchronous: the HID configuration runs from gpTask() once
// onAuthenticationComplete has fired, or after a 3 s timeout for gamepads
// that do not require security.
static void gpConnectAndConfigure()
{
  NimBLEScan* scan = NimBLEDevice::getScan();
  scan->stop();
  scan->clearResults();

  gpClient = NimBLEDevice::createClient();
  gpClient->setClientCallbacks(&gpClientCallbacks, false);
  gpClient->setConnectionParams(12, 24, 0, 200); // 15-30ms interval, 2s supervision timeout
  if (!gpClient->connect(gpTargetAddr)) {
    DEBUG_PRINTLN(F("MyGames: gamepad connect failed."));
    NimBLEDevice::deleteClient(gpClient);
    gpClient = nullptr;
    gpRescanAt = millis() + 2000;
    return;
  }
  DEBUG_PRINTLN(F("MyGames: gamepad connected, waiting for pairing..."));
  gpAuthDone = false;
  gpHidConfigured = false;
  // framing is a per-device property: re-detect for the newly connected pad
  gpNoReportId = false;
  gpIdMismatch = 0;
  gpConnectAt = millis();
  NimBLEDevice::startSecurity(gpClient->getConnId()); // trigger pairing/bonding
}

// read/parse the report map and subscribe to input notifications.
// Blocks the main loop for a moment, once per connection.
static void gpConfigureHid()
{
  NimBLERemoteService* svc = gpClient->getService(NimBLEUUID((uint16_t)0x1812)); // HID service
  if (!svc) {
    DEBUG_PRINTLN(F("MyGames: no HID service, not a gamepad."));
    gpClientLost = true; // reuse the disconnect path for cleanup and rescan
    return;
  }

  // report map -> input report layout
  NimBLERemoteCharacteristic* mapChar = svc->getCharacteristic(NimBLEUUID((uint16_t)0x2A4B));
  if (mapChar && mapChar->canRead()) {
    const std::string map = mapChar->readValue();
#ifdef WLED_DEBUG
    // --- full report map dump (debug builds only): 16 bytes/line with offset ---
    DEBUG_PRINTF_P(PSTR("MyGames: report map %u bytes:\n"), (unsigned)map.size());
    for (size_t off = 0; off < map.size(); off += 16) {
      DEBUG_PRINTF_P(PSTR("MyGames:  %03x:"), (unsigned)off);
      char line[49]; // 16 * " %02x" + NUL
      size_t n = 0;
      for (size_t k = off; k < map.size() && k < off + 16; k++)
        n += snprintf(line + n, sizeof(line) - n, " %02x", (unsigned)(uint8_t)map[k]);
      DEBUG_PRINTF_P(PSTR("%s\n"), line);
    }
#endif
    gpLayout = GpHidLayout(); // reset, so a failed read never leaves a stale layout
    gpParseReportMap((const uint8_t*)map.data(), map.size());
  } else {
    DEBUG_PRINTLN(F("MyGames: report map not readable."));
  }
  if (!gpLayout.valid) {
    DEBUG_PRINTLN(F("MyGames: no usable gamepad report in HID map."));
    gpClientLost = true;
    return;
  }

  // subscribe to every input report characteristic that matches the layout
  std::vector<NimBLERemoteCharacteristic*>* chars = svc->getCharacteristics(true);
  if (!chars) {
    DEBUG_PRINTLN(F("MyGames: HID characteristic discovery failed."));
    gpClientLost = true;
    return;
  }
  for (NimBLERemoteCharacteristic* ch : *chars) {
    if (!ch->canNotify()) continue;
    uint8_t reportId = gpLayout.reportId;
    NimBLERemoteDescriptor* d = ch->getDescriptor(NimBLEUUID((uint16_t)0x2908)); // Report Reference
    if (d) {
      const std::string v = d->readValue(); // [report id, report type]
      if (v.size() >= 2 && v[1] == 1) reportId = v[0]; // 1 = input report
      else continue; // output/feature report, ignore
    }
    if (reportId != gpLayout.reportId) continue;
    if (ch->subscribe(true, gpNotifyCb)) DEBUG_PRINTLN(F("MyGames: subscribed to input reports."));
  }
  gpHidConfigured = true;
}

// one-shot flag for the deferred BLE bring-up (see gpTask())
static bool gpStarted = false;
static void gpStart(); // defined below (NimBLE initialization)

// periodic state machine, called from loop()
static void gpTask()
{
  if (!gpStarted) {
    // Deferred BLE bring-up: WLED performs flash writes during and shortly
    // after boot (WiFi credentials to NVS via WiFi.persistent(true), possible
    // cfg.json creation). On ESP32-C3 a flash write/erase while the BLE
    // controller is running aborts in spi_flash (the BLE interrupt cannot be
    // fully masked during the cache-disabled window of the flash operation),
    // which boot-loops the board. Start scanning only once the network is up
    // (all boot-time flash writes done), or well past boot in AP mode.
    if (millis() < 10000) return;
    if (!Network.isConnected() && millis() < 45000) return;
    gpStart();
    gpStarted = true;
  }
  if (gpClientLost) {
    gpClientLost = false;
    DEBUG_PRINTLN(F("MyGames: gamepad disconnected, rescanning."));
    if (gpClient) {
      NimBLEDevice::deleteClient(gpClient);
      gpClient = nullptr;
    }
    gpRescanAt = millis() + 3000;
  }
  // wait for pairing, then configure HID. Strict devices (Xbox) only allow
  // encrypted GATT reads once the security procedure is complete; gamepads
  // that skip security are covered by the 3 s timeout.
  if (gpClient && !gpHidConfigured) {
    if (gpAuthDone || millis() - gpConnectAt > 3000) gpConfigureHid();
    return;
  }
  if (!gpClient) {
    if (gpTargetFound) {
      gpTargetFound = false;
      gpConnectAndConfigure();
      return;
    }
    // scanning runs until stopped; restart it after the pause expires.
    // results are cleared so a device seen before triggers onResult again
    if (millis() >= gpRescanAt) {
      NimBLEScan* scan = NimBLEDevice::getScan();
      if (!scan->isScanning()) {
        scan->clearResults();
        scan->clearDuplicateCache();
        scan->start(0, gpScanCompleteCb, false);
      }
    }
  }
}

// consume the latest input report and translate it to game controls:
//   left stick up/down, or D-pad up/down: move the paddle
// latest gamepad input state. BLE HID controllers only transmit when a value
// CHANGES (battery saving), so the report handler just stores the values and
// the game integrates them every main-loop iteration - doing the movement
// math per report stalled the paddle until the next stick movement arrived.
static std::atomic<int32_t> gpStickY { 0 };         // left stick Y, deadzoned, +/-32768
static std::atomic<uint32_t> gpHat { 0xFFFFFFFFu }; // raw hat value, 0xFFFFFFFF = neutral
static std::atomic<uint32_t> gpButtons { 0 };       // button bitmap, bit 0 = A (usage 1)

static void gpConsumeInput()
{
  // --- 1) pull the newest report into the persistent input state ---
  const size_t len = gpReportLen;
  if (len) {
    gpReportLen = 0; // consume
    // Some gamepads (this Xbox does) send the input report WITHOUT the
    // report id byte although the map declares one - byte 0 is then already
    // stick data (the low byte of LX). Detect several consecutive
    // notifications whose first byte is not the expected id and latch to
    // id-less framing (kept for the rest of the connection).
    const uint8_t* rep = gpReport;
    bool fresh = true;
    if (gpLayout.reportId && !gpNoReportId) {
      if (len >= 2 && gpReport[0] == gpLayout.reportId) {
        gpIdMismatch = 0;
        rep++;
      } else {
        fresh = false;
        if (++gpIdMismatch >= 4) {
          gpNoReportId = true;
          DEBUG_PRINTLN(F("MyGames: reports carry no report id byte, adjusting."));
        }
      }
    }
#ifdef WLED_DEBUG
    // --- raw report dump (debug builds only). Rate-limited to 5 lines/s for
    // stick-only reports, but any change in the buttons/hat bytes or an
    // unexpected report id prints IMMEDIATELY, so rare inputs (e.g. D-pad)
    // cannot vanish between rate-limit windows.
    static unsigned long lastDump = 0;
    static uint32_t lastAuxLo = 0, lastAuxHi = 0;
    const uint32_t auxLo = (len >= 12) ? (uint32_t)gpReport[8] | ((uint32_t)gpReport[9] << 8)
      | ((uint32_t)gpReport[10] << 16) | ((uint32_t)gpReport[11] << 24) : 0;
    const uint32_t auxHi = (len >= 16) ? (uint32_t)gpReport[12] | ((uint32_t)gpReport[13] << 8)
      | ((uint32_t)gpReport[14] << 16) | ((uint32_t)gpReport[15] << 24) : 0;
    const unsigned long tNow = millis();
    if (tNow - lastDump >= 200 || !fresh || auxLo != lastAuxLo || auxHi != lastAuxHi) {
      lastDump = tNow;
      lastAuxLo = auxLo;
      lastAuxHi = auxHi;
      DEBUG_PRINTF_P(PSTR("MyGames: report[%u]:"), (unsigned)len);
      for (size_t k = 0; k < len; k++) DEBUG_PRINTF_P(PSTR(" %02x"), gpReport[k]);
      if (gpLayout.valid && fresh) {
        const int32_t dax = (gpLayout.axisX >= 0) ? gpAxisValue(rep, gpLayout.axes[gpLayout.axisX]) : 0;
        const int32_t day = (gpLayout.axisY >= 0) ? gpAxisValue(rep, gpLayout.axes[gpLayout.axisY]) : 0;
        const uint32_t dbtn = gpLayout.btnBits ? gpGetBits(rep, gpLayout.btnOffsetBits, gpLayout.btnBits) : 0;
        const uint32_t dhat = gpLayout.hatSizeBits ? gpGetBits(rep, gpLayout.hatOffsetBits, gpLayout.hatSizeBits) : 0xF;
        DEBUG_PRINTF_P(PSTR("  |  X=%d Y=%d btn=0x%x hat=%u off=%d\n"),
          dax, day, (unsigned)dbtn, (unsigned)dhat, (int)gpPaddleOff.load());
      } else {
        DEBUG_PRINTF_P(PSTR("  |  (report id 0x%02x, expected 0x%02x)\n"),
          (unsigned)gpReport[0], (unsigned)gpLayout.reportId);
      }
    }
#endif
    if (gpLayout.valid && fresh) {
      if (gpLayout.axisY >= 0) {
        int32_t ay = gpAxisValue(rep, gpLayout.axes[gpLayout.axisY]);
        if (ay > -2000 && ay < 2000) ay = 0; // deadzone (~6% of full scale)
        gpStickY = ay;
      }
      if (gpLayout.hatSizeBits)
        gpHat = gpGetBits(rep, gpLayout.hatOffsetBits, gpLayout.hatSizeBits);
      if (gpLayout.btnBits)
        gpButtons = gpGetBits(rep, gpLayout.btnOffsetBits, gpLayout.btnBits);
    }
  }

  // --- 2) apply the held input state, every main-loop iteration ---
  // input reaches the game only while its effect is actually shown
  if (strip.getMainSegment().mode != modePongId) return;

  const unsigned long now = millis();
  static unsigned long lastMove = 0;
  static unsigned long lastHatStep = 0;
  static int32_t accPy = 0; // sub-pixel paddle accumulator
  const unsigned long dtMs = now - lastMove;
  lastMove = now;

  // left stick Y: velocity integration over the loop period; full deflection
  // moves the paddle at a fixed 200 px/s (the effect's Speed slider controls
  // the ball speed instead, so both paddles stay on equal terms)
  if (dtMs && dtMs < 200) { // skip huge gaps (e.g. during FS activity)
    // counts*ms needed for one pixel at full deflection = 32768 * 1000 / 200
    constexpr int32_t denom = 163840;
    accPy += gpStickY.load() * (int32_t)dtMs;
    gpPaddleOff += accPy / denom;
    accPy %= denom;
  }

  // hat switch (D-pad): one step on press, then auto-repeat every 120 ms while
  // held; neutral = any value outside the declared logical range (Xbox uses
  // 1..8 with 0 = neutral)
  const int32_t hat = (int32_t)gpHat.load();
  if (gpLayout.hatSizeBits && hat >= gpLayout.hatLogMin && hat <= gpLayout.hatLogMax) {
    static const int8_t dy[8] = { -1, -1, 0, 1, 1, 1, 0, -1 }; // N NE E SE S SW W NW
    if (now - lastHatStep > 120) {
      gpPaddleOff += dy[hat - gpLayout.hatLogMin];
      lastHatStep = now;
    }
  } else {
    lastHatStep = 0; // arm, so the next press steps immediately
  }
}

// one-time initialization, called once from gpTask() after boot has finished
static void gpStart()
{
  // Pre-flight NVS health check: NimBLEDevice::init() aborts the whole board
  // via ESP_ERROR_CHECK(nvs_flash_erase()) when the NVS partition reports no
  // free pages (e.g. after a power loss / crash during an earlier flash
  // write). Do the check and recovery here instead, where a failure is
  // handled gracefully, no BT controller exists yet and WLED keeps running
  // without the gamepad rather than rebooting.
  esp_err_t nvsErr = nvs_flash_init();
  if (nvsErr == ESP_ERR_NVS_NO_FREE_PAGES || nvsErr == ESP_ERR_NVS_NEW_VERSION_FOUND) {
    DEBUG_PRINTLN(F("MyGames: NVS needs recovery, erasing..."));
    nvsErr = nvs_flash_erase();
    if (nvsErr == ESP_OK) nvsErr = nvs_flash_init();
  }
  if (nvsErr != ESP_OK) {
    DEBUG_PRINTF_P(PSTR("MyGames: NVS unusable (%d), BLE disabled.\n"), nvsErr);
    return;
  }

  // WiFi/BT coexistence policy (ESP32-C3/S3): the coexist core aborts in
  // coex_core_enable() at the second coex enable (our esp_bt_controller_enable
  // after WiFi is already up) when WiFi modem sleep is disabled:
  // "Error! Should enable WiFi modem sleep when both WiFi and Bluetooth are
  // enabled!!!" WLED defaults to noWifiSleep = true (WiFi.setSleep(false),
  // wled.cpp), so modem sleep must be forced back on before the BT controller
  // starts. Keep it on while the gamepad runs - slightly higher WiFi latency
  // and power draw is the price of WiFi+BLE coexistence on these chips.
  WiFi.setSleep(true);
  DEBUG_PRINTLN(F("MyGames: WiFi modem sleep enabled for coexistence"));

  DEBUG_PRINTF_P(PSTR("MyGames: starting BLE init, free heap %u\n"), ESP.getFreeHeap());
  NimBLEDevice::init("WLED-MyGames");
  DEBUG_PRINTF_P(PSTR("MyGames: BLE host synced, free heap %u\n"), ESP.getFreeHeap());
  NimBLEDevice::setSecurityAuth(true, false, true); // bonding, no MITM (Just Works), LE secure connections
  NimBLEDevice::setSecurityIOCap(BLE_HS_IO_NO_INPUT_OUTPUT);

  NimBLEScan* scan = NimBLEDevice::getScan();
  scan->setAdvertisedDeviceCallbacks(&gpScanCallbacks, false);
  scan->setActiveScan(true);
  scan->setInterval(97); // ~60/30ms interval/window: keeps radio time for WiFi
  scan->setWindow(48);
  scan->start(0, gpScanCompleteCb, false); // continuous scan until something is found

  // NOTE: pairing keys are stored in NVS, so the gamepad reconnects
  // automatically after a reboot. Uncomment to pair from scratch:
  // NimBLEDevice::deleteAllBonds();
}

#endif // MYGAMES_BLUEPAD32

// renormalize the ball velocity after a paddle hit: total speed is capped at
// basePx (the slider speed) and the horizontal component keeps a minimum
// share, so the ball never exceeds the set pace and every rally advances
//   dir     - horizontal direction after the bounce (+1 = right, -1 = left)
//   spinAdd - vertical velocity added by the hit position (edge hits steer)
static void gpPongBounce(float& vx, float& vy, float dir, float basePx, float spinAdd)
{
  vy += spinAdd;
  vx = dir * fabsf(vx);
  const float sp2 = vx * vx + vy * vy;
  if (sp2 > basePx * basePx) {
    const float s = basePx / sqrtf(sp2);
    vx *= s;
    vy *= s;
  }
  const float minVx = 0.35f * basePx;
  if (fabsf(vx) < minVx) {
    vx = dir * minVx;
    vy = (vy >= 0.0f ? 1.0f : -1.0f) * sqrtf(basePx * basePx - minVx * minVx);
  }
}

/*
 * The 2D "Pong" effect: the player paddle (a 1x3 block in the rightmost
 * column, moved by the gamepad) against a red AI enemy paddle in the
 * leftmost column, with a small ball bouncing between them. Whoever lets
 * the ball pass their paddle loses: the winner's color flashes and the
 * game waits for the gamepad's A button to restart. Without a connected
 * gamepad (or in builds without MYGAMES_BLUEPAD32) the player paddle is
 * AI-driven as well and the game restarts by itself, so the panel keeps
 * playing as a demo.
 */
void mode_2DPong()
{
  if (!strip.isMatrix) { // not a 2D set-up
    SEGMENT.fill(SEGCOLOR(0));
    return;
  }

  // NOTE: coordinates are plain "int", not int32_t - on the ESP32-C3/RISC-V
  // toolchain int32_t is "long int", which makes setPixelColorXY() overloads
  // ambiguous (int vs unsigned conversion of "long" has equal rank)
  const int cols = SEGMENT.virtualWidth();
  const int rows = SEGMENT.virtualHeight();
  if (!cols || !rows) return;

  // NOTE: the game state lives in function-local statics, so this effect is
  // meant to run on ONE segment (the main one) - two instances would share
  // the same ball
  enum PongState : uint8_t { PG_SERVE, PG_PLAY, PG_OVER };
  static PongState state = PG_SERVE;
  static uint32_t stateAt = 0;    // millis() when the current state was entered
  static bool playerWon = false;  // who won the last finished game (flash color)
  static float ballX = 0.0f, ballY = 0.0f;   // ball position, px
  static float ballVx = 0.0f, ballVy = 0.0f; // ball velocity, px/s
  static float enemyOff = 0.0f;   // enemy paddle offset from panel center, px
  static uint32_t lastFrame = 0;
  static bool lastBtnA = false;   // previous A-button state (edge detection)

  const uint32_t now = millis();
  if (SEGENV.call == 0) { // effect (re)started: serve a fresh game
    state = PG_SERVE;
    stateAt = now;
    ballX = (float)(cols / 2);
    ballY = (float)(rows / 2);
    ballVx = ballVy = 0.0f;
    enemyOff = 0.0f;
    lastBtnA = false;
    lastFrame = now;
  }
  uint32_t dtMs = now - lastFrame;
  lastFrame = now;
  if (dtMs > 100) dtMs = 100; // clamp long gaps (filesystem activity, network)
  const float dt = (float)dtMs / 1000.0f;

  // Speed slider: ball speed, 1..12 px/s (default 6.5) - kept slow enough to
  // stay easy to follow on the matrix
  const float basePx = 1.0f + ((float)SEGMENT.speed * 35.0f) / 255.0f;
  // Intensity slider: AI paddle top speed as a fraction of the ball speed
  // (0.30 = easy to beat with angled shots, 0.95 = very hard to beat)
  const float aiFrac = 0.30f + ((float)SEGMENT.intensity * 0.65f) / 255.0f;

  // 1x3 paddles; on very small panels they shrink to the panel height.
  // offMin/offMax are the offset limits keeping a paddle fully on the panel.
  const int h = min((int)rows, 3);
  const int half = h / 2;
  const int offMin = half - (int)rows / 2;
  const int offMax = (int)rows - h - ((int)rows / 2 - half);

  // gamepad A button (button 1) and demo-mode detection
  bool btnA = false;
  bool demo = true;
#ifdef MYGAMES_BLUEPAD32
  btnA = (gpButtons.load() & 1u) != 0u; // bit 0 = first button = A on Xbox
  demo = (gpClient == nullptr); // no gamepad connected: player side is AI-driven
#endif
  const bool btnAPressed = btnA && !lastBtnA; // rising edge only
  lastBtnA = btnA;

  // game over: the A button restarts (with a gamepad); without one the game
  // restarts itself after a pause, so the demo keeps running
  if (state == PG_OVER && ((btnAPressed && !demo) || (demo && now - stateAt > 4000))) {
    state = PG_SERVE;
    stateAt = now;
    ballX = (float)(cols / 2);
    ballY = (float)(rows / 2);
    ballVx = ballVy = 0.0f;
  }

  // --- player paddle (right column): gamepad offset, or demo AI ---
  int pOff = 0;
#ifdef MYGAMES_BLUEPAD32
  pOff = gpPaddleOff.load();
#endif
  if (demo && state != PG_OVER) {
    // same tracking rule as the enemy AI, slightly slower so demo rallies
    // still end: follow the incoming ball, else drift back to center
    const float target = (ballVx > 0.0f) ? (ballY - (float)(rows / 2)) : 0.0f;
    float d = target - (float)pOff;
    const float maxStep = basePx * aiFrac * 0.9f * dt;
    if (d > maxStep) d = maxStep;
    else if (d < -maxStep) d = -maxStep;
    pOff += (int)(d + (d >= 0.0f ? 0.5f : -0.5f));
  }
  pOff = constrain(pOff, offMin, offMax);
#ifdef MYGAMES_BLUEPAD32
  // write back the clamped position so the gamepad cannot "wind up" an
  // offset that is larger than the panel allows
  gpPaddleOff = pOff;
#endif
  const int pTop = rows / 2 + pOff - half; // player paddle top row

  // --- enemy paddle (left column): speed-limited AI ---
  if (state != PG_OVER) {
    // track the ball while it approaches, else drift back to the center;
    // the speed cap is what makes the AI beatable with angled shots
    const float target = (ballVx < 0.0f) ? (ballY - (float)(rows / 2)) : 0.0f;
    float d = target - enemyOff;
    const float maxStep = basePx * aiFrac * dt;
    if (d > maxStep) d = maxStep;
    else if (d < -maxStep) d = -maxStep;
    enemyOff += d;
    if (enemyOff < (float)offMin) enemyOff = (float)offMin;
    else if (enemyOff > (float)offMax) enemyOff = (float)offMax;
  }
  const int eTop = constrain(rows / 2 + (int)enemyOff - half, 0, (int)rows - h);

  // --- game state machine ---
  if (state == PG_SERVE) {
    // ball blinks at the panel center, then serves toward a random side
    if (now - stateAt > 1200) {
      // serve toward a random side, with a slight angle, within the envelope
      ballVx = (random(2) ? 1.0f : -1.0f) * 0.94f * basePx;
      ballVy = (random(2) ? 1.0f : -1.0f) * 0.34f * basePx;
      state = PG_PLAY;
      stateAt = now;
    }
  } else if (state == PG_PLAY) {
    const float prevX = ballX, prevY = ballY;
    ballX += ballVx * dt;
    ballY += ballVy * dt;

    // top / bottom walls: the ball reaches the outermost rows here (only the
    // paddle planes reverse early, keeping their one-pixel gap)
    if (ballY < 0.0f) { ballY = 0.0f; ballVy = fabsf(ballVy); }
    else if (ballY > (float)rows - 1.0f) { ballY = (float)rows - 1.0f; ballVy = -fabsf(ballVy); }

    // paddle collisions, checked as swept plane crossings one pixel BEFORE
    // the paddle column, so the ball reverses without ever touching it
    const float pPlane = (float)(cols - 2); // one px gap to the player paddle
    const float lPlane = 1.0f;              // one px gap to the enemy paddle
    if (ballVx > 0.0f && prevX <= pPlane && ballX > pPlane) {
      const float t = (pPlane - prevX) / (ballX - prevX);
      const float yAt = prevY + t * (ballY - prevY);
      if ((int)(yAt + 0.5f) >= pTop && (int)(yAt + 0.5f) < pTop + h) {
        ballX = pPlane;
        ballY = yAt;
        // edge hits steer the return angle
        gpPongBounce(ballVx, ballVy, -1.0f, basePx, (yAt - (float)(pTop + half)) * 0.8f);
      }
    } else if (ballVx < 0.0f && prevX >= lPlane && ballX < lPlane) {
      const float t = (lPlane - prevX) / (ballX - prevX);
      const float yAt = prevY + t * (ballY - prevY);
      if ((int)(yAt + 0.5f) >= eTop && (int)(yAt + 0.5f) < eTop + h) {
        ballX = lPlane;
        ballY = yAt;
        gpPongBounce(ballVx, ballVy, 1.0f, basePx, (yAt - (float)(eTop + half)) * 0.8f);
      }
    }

    // a ball that got past a paddle plane unhit ends the game: that side lost
    if (ballVx > 0.0f && ballX > pPlane) { playerWon = false; state = PG_OVER; stateAt = now; }
    else if (ballVx < 0.0f && ballX < lPlane) { playerWon = true; state = PG_OVER; stateAt = now; }
  }

  // --- draw ---
  const uint32_t playerCol = SEGCOLOR(0);
  const uint32_t bgCol = SEGCOLOR(1);
  const uint32_t enemyCol = RGBW32(255, 0, 0, 0); // enemy paddle is always red

  if (state == PG_OVER && now - stateAt < 900) {
    SEGMENT.fill(playerWon ? playerCol : enemyCol); // flash the winner's color
    return;
  }

  SEGMENT.fill(bgCol);
  for (int dy = 0; dy < h; dy++) {
    SEGMENT.setPixelColorXY(cols - 1, pTop + dy, playerCol);
    SEGMENT.setPixelColorXY(0, eTop + dy, enemyCol);
  }
  // ball: blinking while waiting to serve, solid during play
  if (state == PG_PLAY || (state == PG_SERVE && ((now / 200) & 1))) {
    const int bx = constrain((int)(ballX + 0.5f), 0, cols - 1);
    const int by = constrain((int)(ballY + 0.5f), 0, rows - 1);
    SEGMENT.setPixelColorXY(bx, by, playerCol);
  }
}

// Effect data string (parsed by the web UI):
//   "Pong"      - effect name
//   @ list      - slider/checkbox labels in fixed order:
//                 Speed, Intensity, Custom1..3, Check1..3 (empty = hidden);
//                 here Speed = ball speed, Intensity = AI paddle skill
//   color list  - names for color slots 0..2
//   "2"         - effect requires a 2D matrix
//   key=value   - default values (sx = speed)
static const char _data_FX_MODE_2DPONG[] PROGMEM =
  "Pong@Ball speed,AI skill,,,,,;Player,Background;;2;sx=128";

// AI: end

class MyGamesUsermod : public Usermod
{
  public:
    void setup() override
    {
      // id 255 => find the first free effect slot; addEffect() returns the
      // assigned index, which gpConsumeInput() needs to detect the active game
      modePongId = strip.addEffect(255, &mode_2DPong, _data_FX_MODE_2DPONG);
      // NOTE: the BLE stack is deliberately NOT started here — usermod
      // setup() runs while WLED still performs boot-time flash writes, and
      // flash writes must not happen with the BLE controller active (see
      // the deferred bring-up comment in gpTask())
    }

    void loop() override
    {
#ifdef MYGAMES_BLUEPAD32
      gpTask(); // deferred BLE bring-up + scan/connect/disconnect state machine
      gpConsumeInput(); // route the latest HID report to the paddle
#else
      // rendering is handled by the effects, which are driven by
      // strip.service(); nothing to poll here
#endif
    }

    // no getId(): this usermod needs no inter-usermod communication, no pin
    // ownership and no JSON info entry (see AGENTS.md "Usermod IDs")
};

static MyGamesUsermod mygames;
REGISTER_USERMOD(mygames);
